## config/boards/arm/sf65/Kconfig.board
```kconfig
# BlueSof board configuration

# Copyright (c) 2020 Eric Lau
# SPDX-License-Identifier: MIT

config BOARD_SF65
	bool "COBO SF65"
	depends on SOC_NRF52840_QIAA
```

## config/boards/arm/sf65/Kconfig.defconfig
```kconfig
# Copyright (c) 2020 Eric Lau
# SPDX-License-Identifier: MIT

if BOARD_SF65

config ZMK_KEYBOARD_NAME
	default "COBO SF65"

config BOARD
	default "sf65"

menuconfig SENSOR
    bool "Sensor Drivers"

config BT_CTLR
	default BT

config ZMK_BLE
	default y

config ZMK_USB
	default y

# config ZMK_BATTERY_VOLTAGE_DIVIDER
# 	default y

if USB

config USB_NRFX
	default y

config USB_DEVICE_STACK
	default y

endif # USB

endif # BOARD_SF65
```

## config/west.yml
```yaml
manifest:
  remotes:
    - name: zmkfirmware
      url-base: https://github.com/zmkfirmware
    - name: ericrlau
      url-base: https://github.com/ericrlau/
  projects:
    - name: zmk
      remote: zmkfirmware
      revision: main
      import: app/west.yml
  self:
    path: config
```
