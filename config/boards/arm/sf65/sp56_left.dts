/*
 * Copyright (c) 2020 Eric Lau
 *
 * SPDX-License-Identifier: MIT
 */

#include "sp56.dtsi"

&kscan0 {
	col-gpios
		= <&gpio0 30 GPIO_ACTIVE_HIGH>
		, <&gpio0 31 GPIO_ACTIVE_HIGH>
		, <&gpio0 29 GPIO_ACTIVE_HIGH>
		, <&gpio0  2 GPIO_ACTIVE_HIGH>
		, <&gpio1 13 GPIO_ACTIVE_HIGH>
		, <&gpio0 28 GPIO_ACTIVE_HIGH>
		;
};

&left_encoder {
    status = "okay";
};
